
//=======================================================
//  This code is generated by Terasic System Builder
//=======================================================

module Counter(

	//////////// CLOCK //////////
	input 		          		MAX10_CLK1_50,


	//////////// KEY //////////
	input 		     [1:0]		KEY,

	//////////// LED //////////
	output		     [9:0]		LEDR,

	//////////// SW //////////
	input 		     [9:0]		SW
);



//=======================================================
//  REG/WIRE declarations
//=======================================================
	 wire reset1;
	 wire load1; 
	 wire up_down1;
    wire [3:0] data_in1;
    wire [3:0] count1;
	 //wire countClock;
	 wire clk;
	 assign clk = MAX10_CLK1_50;
	 assign reset1 = KEY[0];
	 assign up_down1 = KEY[1];
	 assign data_in1 = SW[3:0];
	 assign load1 = SW[9];
	 assign LEDR[3:0] = count1;
	UpDownCounter C1 (clk, reset1, load1, up_down1, data_in1, count1);
endmodule


module UpDownCounter(
    input clk, reset, load, up_down,
    input [3:0] data_in,
    output reg [3:0] count,
	 wire countTemp,
	 wire clkTemp
);

always @(posedge clk) begin
	 if (clk)
			countTemp <= countTemp+1;
	     if(countTemp = 50000000-1)
            clkTemp <= 1;
	     else 
	     clkTemp <= 0;
end
		  
always @(posedge clkTemp or posedge reset) begin
    if (reset)
        count <= 4'b0000;
    else if (load)
        count <= data_in;
    else if (up_down)
        count <= count + 1;  // Count Up
    else
        count <= count - 1;  // Count Down
end
endmodule


